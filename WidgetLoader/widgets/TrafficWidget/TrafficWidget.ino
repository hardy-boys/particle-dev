#include "./TrafficWidget.h"

// Icons
const unsigned char traffic_icon[] = {
	0x00, 0x00, 0x00, 0x00, 0x00, 0x00, 0x00, 0x00, 0x00, 0x00, 0x00, 0x00, 0x00, 0x00, 0x00, 0x00, 
	0x00, 0x00, 0x00, 0x00, 0x00, 0x00, 0x00, 0x00, 0x00, 0x00, 0x00, 0x00, 0x00, 0x00, 0x00, 0x00, 
	0x00, 0x00, 0x00, 0x00, 0x00, 0x00, 0x00, 0x00, 0x00, 0x00, 0x00, 0x00, 0x00, 0x00, 0x00, 0x00, 
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	0x00, 0x00, 0x00, 0x00, 0x00, 0x00, 0x00, 0x00, 0x00, 0x00, 0x00, 0x00, 0x00, 0x00, 0x00, 0x00
};

//
// ───  SETUP AND LOOP ─────────────────────────────────────────────────────────────
//

void TrafficWidget::widget_setup()
{
	Serial.println("Traffic widget loaded");

	// Event listeners
	Particle.subscribe("traffic", [this](const char *a, const char *b) { streamDataHandler(a, b); });
}

void TrafficWidget::widget_loop()
{
	tft.setTextSize(1);
	tft.setFont(CALIBRI_48);
	tft.setTextColor(ILI9341_BLACK, ILI9341_WHITE);

	// Traffic time & distance

	// set color based on traffic
	int time_diff = traffic_time.toInt() - normal_time.toInt();
	if(time_diff >= 0 && time_diff < 5) {
		tft.setTextColor(ILI9341_GREEN, ILI9341_WHITE);
	} else if(time_diff >= 5 && time_diff < 10) {
		tft.setTextColor(ILI9341_YELLOW, ILI9341_WHITE);
	} else if(time_diff > 10) {
		tft.setTextColor(ILI9341_RED, ILI9341_WHITE);
	}

	tft.setCursor(TRAFFICTIME_START_V, TRAFFICTIME_START_H);
	tft.println(traffic_time);

	tft.setTextColor(ILI9341_BLACK, ILI9341_WHITE);
	tft.setCursor(DISTANCE_START_V, DISTANCE_START_H);
	tft.println(distance);

}

//
// ─── UTIL FUNCTIONS ─────────────────────────────────────────────────────────────
//

void TrafficWidget::streamDataHandler(const char *event, const char *data)
{
	// Allocate buffer for handling JSON, automatically destoyed after this handler finishes
	StaticJsonBuffer<256> jsonBuffer;

	Serial.print("Recieved event: ");
	Serial.println(event);
	if (data)
	{
		int length = strlen(data) + 1;
		char dataCopy[length];
		strcpy(dataCopy, data);
		Serial.print("Recieved data: ");
		Serial.println(dataCopy);
		JsonObject &root = jsonBuffer.parseObject(dataCopy);
		if (!root.success())
		{
			Particle.publish("parseArray() failed");
			Serial.println("parseArray() failed");
			return;
		}

		// Update JSON data into our display variables
		// {"Distance":"23 mi","TrafficTime":"33 min"}
		distance = root["Distance"].asString();
		traffic_time = root["TrafficTime"].asString();
		normal_time = root["NormalTime"].asString();

		Serial.println("Traffic status updated");
	}
	else
	{
		Serial.println("NULL");
	}
	digitalWrite(blinkLed, HIGH);
	delay(500);
	digitalWrite(blinkLed, LOW);
}

void TrafficWidget::screenInit()
{
	Serial.println("Rendering TrafficWidget");

	// Sync time with particle cloud
	Particle.syncTime();
	waitUntil(Particle.syncTimeDone);

	/***** Initial screen setup *****/
	tft.begin();
	tft.setRotation(1);
	tft.fillScreen(ILI9341_WHITE);
	tft.drawFastHLine(0, 50, 320, ILI9341_BLACK);
	tft.drawFastVLine(60, 0, 50, ILI9341_BLACK);

	tft.setCursor(96, 12);
	tft.setTextColor(ILI9341_BLACK);
	tft.setTextWrap(false);
	tft.setTextSize(1);
	tft.setFont(CALIBRI_24);

	tft.println("   Traffic    Updates");
	tft.drawBitmap(6, 0, traffic_icon, 48, 48, ILI9341_BLUE);
}